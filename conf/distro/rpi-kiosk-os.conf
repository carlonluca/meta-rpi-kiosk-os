## conf/distro/rpi-kiosk-os.conf
```bitbake
DISTRO = "rpi-kiosk-os"
DISTRO_NAME = "rpi-kiosk-os"
DISTRO_VERSION = "0.1"

# Use a base policy (recommended)
require conf/distro/poky.conf

# Package format
PACKAGE_CLASSES = "package_ipk"

INIT_MANAGER = "systemd"

DISTRO_FEATURES:append = " systemd"
DISTRO_FEATURES:append = " webengine cups dbus pulseaudio opengl usrmerge plymouth"
DISTRO_FEATURES:remove = "x11 wayland vulkan bluetooth nfs ppp zeroconf"

PACKAGECONFIG:append:pn-qtbase = " kms gbm tslib kms gbm zstd libproxy gssapi mtdev cups sql-sqlite journald"

hostname:pn-base-files = "rpi-kiosk-os"
```
