## conf/layer.conf
```bitbake
BBPATH .= ":${LAYERDIR}"
BBFILES += "${LAYERDIR}/recipes-*/*/*.bb \
            ${LAYERDIR}/recipes-*/*/*.bbappend"
BBFILE_COLLECTIONS += "meta-rpi-kiosk-os"
BBFILE_PATTERN_meta-rpi-kiosk-os = "^${LAYERDIR}/"
BBFILE_PRIORITY_meta-rpi-kiosk-os = "6"
LAYERDEPENDS_meta-rpi-kiosk-os = "core"
LAYERSERIES_COMPAT_meta-rpi-kiosk-os = "scarthgap"
```
